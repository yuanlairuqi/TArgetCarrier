## 01_TargetCarrier -geek-UART/靶车/firmware/esp32_bridge/ble_direct/main/Kconfig.projbuild
```kconfig
menu "Target encrypted ESP-NOW"
config ROBOT_ESPNOW_ENABLED
    bool "Enable encrypted ESP-NOW receiver alongside BLE"
    default n
    help
        One paired GEEK controller, unicast only. A valid radio STOP session owns
        control exclusively until timeout. BLE emergency STOP remains available.
        Empty or invalid MAC/keys leave wireless control disabled.
config ROBOT_ESPNOW_NODE_ID
    int "Node ID (unique for this controlled node)"
    range 2 2
    default 2
    depends on ROBOT_ESPNOW_ENABLED
config ROBOT_ESPNOW_CHANNEL
    int "Shared 2.4GHz channel (must match the controller)"
    range 1 13
    default 1
    depends on ROBOT_ESPNOW_ENABLED
config ROBOT_ESPNOW_CONTROLLER_MAC
    string "Controller Wi-Fi STA MAC (aa:bb:cc:dd:ee:ff)"
    default ""
    depends on ROBOT_ESPNOW_ENABLED
config ROBOT_ESPNOW_PMK
    string "Private PMK (32 hex digits; do not commit)"
    default ""
    depends on ROBOT_ESPNOW_ENABLED
config ROBOT_ESPNOW_AUTH_KEY
    string "Private application HMAC key (64 hex digits; do not commit)"
    default ""
    depends on ROBOT_ESPNOW_ENABLED
config ROBOT_ESPNOW_LMK
    string "Private peer LMK (32 hex digits; do not commit)"
    default ""
    depends on ROBOT_ESPNOW_ENABLED
endmenu
```

## 02_TargetCarrier -geek-I2C/x轴/esp_无线从机_20261022/components/link_led/Kconfig
```kconfig
menu "WS2812 connection indicator"
config LINK_LED_ENABLED
    bool "Enable GPIO10 WS2812 connection indicator"
    default y
config LINK_LED_COUNT
    int "Number of chained WS2812 LEDs"
    range 1 32
    default 3
    depends on LINK_LED_ENABLED
config LINK_LED_BRIGHTNESS
    int "Channel brightness (0..32)"
    range 0 32
    default 8
    depends on LINK_LED_ENABLED
endmenu
```

## 02_TargetCarrier -geek-I2C/靶车/firmware/esp32_bridge/ble_direct/sdkconfig.defaults
```kconfig
CONFIG_BT_ENABLED=y
CONFIG_BT_NIMBLE_ENABLED=y
CONFIG_BT_NIMBLE_MAX_CONNECTIONS=1
CONFIG_BT_NIMBLE_ROLE_CENTRAL=n
CONFIG_BT_NIMBLE_ROLE_OBSERVER=n
CONFIG_BT_NIMBLE_ROLE_BROADCASTER=y
CONFIG_BT_NIMBLE_ROLE_PERIPHERAL=y
CONFIG_ESPTOOLPY_FLASHSIZE_4MB=y
CONFIG_ESP_MAIN_TASK_STACK_SIZE=8192
CONFIG_PARTITION_TABLE_CUSTOM=y
CONFIG_PARTITION_TABLE_CUSTOM_FILENAME="partitions.csv"

CONFIG_ESP_COEX_SW_COEXIST_ENABLE=y
CONFIG_ROBOT_ESPNOW_ENABLED=y
CONFIG_ROBOT_ESPNOW_NODE_ID=2
CONFIG_ROBOT_ESPNOW_CHANNEL=1
```

## verification/link_stability_20261023/backup/geek/sdkconfig.defaults
```kconfig
CONFIG_IDF_TARGET="esp32s3"
CONFIG_ESPTOOLPY_FLASHSIZE_16MB=y
CONFIG_ESP_MAIN_TASK_STACK_SIZE=8192
CONFIG_ESP_WIFI_NVS_ENABLED=n
CONFIG_ESP_CONSOLE_UART_DEFAULT=y
CONFIG_ROBOT_ESPNOW_ENABLED=y
CONFIG_ROBOT_ESPNOW_NODE_ID=1
CONFIG_ROBOT_ESPNOW_CHANNEL=1
```

## x轴/verification/oled_20261021/backup/esp/main/Kconfig.projbuild
```kconfig
menu "Robot battery input (disabled until wiring is confirmed)"
config ROBOT_BATTERY_ENABLED
    bool "Enable real ADC battery input"
    default n
    help
        Connect a verified resistor divider first. Never connect a battery
        directly to the ADC pin. ESP32-S3 ADC1 channel 0 corresponds to GPIO1.
config ROBOT_BATTERY_CHANNEL
    int "ADC1 channel (0..9 maps to GPIO1..10 on ESP32-S3)"
    range 0 9
    default 0
    depends on ROBOT_BATTERY_ENABLED
config ROBOT_BATTERY_R_TOP
    int "Divider resistor: battery to ADC (ohm)"
    range 1 1000000
    default 100000
    depends on ROBOT_BATTERY_ENABLED
config ROBOT_BATTERY_R_BOTTOM
    int "Divider resistor: ADC to GND (ohm)"
    range 1 1000000
    default 33000
    depends on ROBOT_BATTERY_ENABLED
endmenu
menu "Robot UART to STM32 (configure after hardware confirmation)"
config ROBOT_UART_ENABLED
    bool "Enable STM32 UART bridge"
    default n
config ROBOT_UART_PORT
    int "ESP32 UART port (do not use console UART0)"
    range 1 2
    default 1
    depends on ROBOT_UART_ENABLED
config ROBOT_UART_TX_GPIO
    int "TX GPIO (-1 = hardware not decided)"
    range -1 48
    default -1
    depends on ROBOT_UART_ENABLED
config ROBOT_UART_RX_GPIO
    int "RX GPIO (-1 = hardware not decided)"
    range -1 48
    default -1
    depends on ROBOT_UART_ENABLED
config ROBOT_UART_BAUD
    int "UART baud rate, 8 data bits, no parity, 1 stop bit"
    range 9600 2000000
    default 115200
    depends on ROBOT_UART_ENABLED
endmenu

menu "PUL/DIR hardware logic capture (3.3V inputs only)"
config ROBOT_PULSE_CAPTURE_ENABLED
    bool "Enable two-channel MCPWM hardware input capture"
    default n
    help
        Measure the STM32 PA8/PB0 3.3V output nodes, with common ground.
        Do not connect driver PUL+/PUL-/DIR+/DIR- terminals to ESP GPIOs.
config ROBOT_PULSE_PUL_GPIO
    int "PUL input GPIO"
    range 0 48
    default 6
    depends on ROBOT_PULSE_CAPTURE_ENABLED
config ROBOT_PULSE_DIR_GPIO
    int "DIR input GPIO"
    range 0 48
    default 7
    depends on ROBOT_PULSE_CAPTURE_ENABLED
endmenu

menu "GEEK ESP-NOW control input (private pairing required)"
config ROBOT_ESPNOW_ENABLED
    bool "Enable encrypted ESP-NOW receiver alongside BLE"
    default n
    help
        One paired GEEK controller, unicast only. BLE connections own control;
        remote control needs a STOP handshake after BLE disconnect or timeout.
        Empty or invalid MAC/keys leave wireless control disabled.
config ROBOT_ESPNOW_NODE_ID
    int "Node ID (unique for this controlled node)"
    range 1 65535
    default 1
    depends on ROBOT_ESPNOW_ENABLED
config ROBOT_ESPNOW_CHANNEL
    int "Shared 2.4GHz channel (must match the controller)"
    range 1 13
    default 1
    depends on ROBOT_ESPNOW_ENABLED
config ROBOT_ESPNOW_CONTROLLER_MAC
    string "Controller Wi-Fi STA MAC (aa:bb:cc:dd:ee:ff)"
    default ""
    depends on ROBOT_ESPNOW_ENABLED
config ROBOT_ESPNOW_PMK
    string "Private PMK (32 hex digits; do not commit)"
    default ""
    depends on ROBOT_ESPNOW_ENABLED
config ROBOT_ESPNOW_AUTH_KEY
    string "Private application HMAC key (64 hex digits; do not commit)"
    default ""
    depends on ROBOT_ESPNOW_ENABLED
config ROBOT_ESPNOW_LMK
    string "Private peer LMK (32 hex digits; do not commit)"
    default ""
    depends on ROBOT_ESPNOW_ENABLED
endmenu
```

## 靶车/ESP32-S3-GEEK/main/Kconfig.projbuild
```kconfig
menu "GEEK USB to paired ESP-NOW slave"
config ROBOT_ESPNOW_ENABLED
    bool "Compile the encrypted unicast link"
    default y
    help
        Missing real STA MAC or keys keeps wireless disabled at runtime.
        No broadcast motion or automatic pairing is supported.
config ROBOT_ESPNOW_NODE_ID
    int "Selected slave node ID"
    range 1 65535
    default 1
config ROBOT_ESPNOW_CHANNEL
    int "Shared 2.4GHz channel"
    range 1 13
    default 1
config ROBOT_ESPNOW_CONTROLLER_MAC
    string "Paired SLAVE Wi-Fi STA MAC (legacy shared field name)"
    default ""
    depends on ROBOT_ESPNOW_ENABLED
config ROBOT_ESPNOW_PMK
    string "Private PMK (32 hex digits; local file only)"
    default ""
    depends on ROBOT_ESPNOW_ENABLED
config ROBOT_ESPNOW_LMK
    string "Private peer LMK (32 hex digits; local file only)"
    default ""
    depends on ROBOT_ESPNOW_ENABLED
config ROBOT_ESPNOW_AUTH_KEY
    string "Private application HMAC key (64 hex digits; local file only)"
    default ""
    depends on ROBOT_ESPNOW_ENABLED
endmenu
```

## 靶车/x轴/verification/oled_20261021/backup/esp/sdkconfig.defaults
```kconfig
CONFIG_BT_ENABLED=y
CONFIG_BT_NIMBLE_ENABLED=y
CONFIG_BT_NIMBLE_MAX_CONNECTIONS=1
CONFIG_BT_NIMBLE_ROLE_CENTRAL=n
CONFIG_BT_NIMBLE_ROLE_OBSERVER=n
CONFIG_BT_NIMBLE_ROLE_BROADCASTER=y
CONFIG_BT_NIMBLE_ROLE_PERIPHERAL=y
CONFIG_ESPTOOLPY_FLASHSIZE_4MB=y
CONFIG_ROBOT_BATTERY_ENABLED=n
CONFIG_ROBOT_UART_ENABLED=y
CONFIG_ROBOT_UART_PORT=1
CONFIG_ROBOT_UART_TX_GPIO=4
CONFIG_ROBOT_UART_RX_GPIO=5
CONFIG_ROBOT_UART_BAUD=115200

CONFIG_ROBOT_PULSE_CAPTURE_ENABLED=y
CONFIG_ROBOT_PULSE_PUL_GPIO=6
CONFIG_ROBOT_PULSE_DIR_GPIO=7
```
