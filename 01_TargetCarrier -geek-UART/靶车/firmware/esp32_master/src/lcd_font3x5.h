/**
 * @file    lcd_font3x5.h
 * @brief   3x5 像素字模 —— 从 lib/oled/oled.c 抽取, 给主机 ST7789 屏复用
 *
 *  3 列 x 5 行, 每个字 3 字节 (每字节一列, bit0 = 顶行)。
 *  这个头文件是自动生成的副本, 要改字形请改 lib/oled/oled.c 再重新抽。
 */
#ifndef LCD_FONT3X5_H
#define LCD_FONT3X5_H

#include <stdint.h>

typedef struct {
    char    ch;
    uint8_t col[3];
} glyph3x5_t;

static const glyph3x5_t s_lcd_font[] = {
    {' ', {0x00, 0x00, 0x00}},
    {'-', {0x00, 0x04, 0x00}},
    {'.', {0x00, 0x00, 0x20}},
    {':', {0x00, 0x0A, 0x00}},
    {'/', {0x10, 0x04, 0x00}},
    {'%', {0x12, 0x04, 0x09}},
    {'+', {0x04, 0x0E, 0x04}},
    {'_', {0x10, 0x10, 0x10}},

    {'0', {0x1F, 0x11, 0x1F}},
    {'1', {0x00, 0x1F, 0x00}},
    {'2', {0x1D, 0x15, 0x17}},
    {'3', {0x15, 0x15, 0x1F}},
    {'4', {0x07, 0x04, 0x1F}},
    {'5', {0x17, 0x15, 0x1D}},
    {'6', {0x1F, 0x15, 0x1D}},
    {'7', {0x01, 0x19, 0x05}},
    {'8', {0x1F, 0x15, 0x1F}},
    {'9', {0x17, 0x15, 0x1F}},

    {'A', {0x1E, 0x05, 0x1E}},
    {'B', {0x1F, 0x15, 0x0A}},
    {'C', {0x0E, 0x11, 0x11}},
    {'D', {0x1F, 0x11, 0x0E}},
    {'E', {0x1F, 0x15, 0x15}},
    {'F', {0x1F, 0x05, 0x05}},
    {'G', {0x0E, 0x11, 0x1D}},
    {'H', {0x1F, 0x04, 0x1F}},
    {'I', {0x11, 0x1F, 0x11}},
    {'J', {0x08, 0x10, 0x0F}},
    {'K', {0x1F, 0x04, 0x1B}},
    {'L', {0x1F, 0x10, 0x10}},
    {'M', {0x1F, 0x02, 0x1F}},
    {'N', {0x1F, 0x0E, 0x1F}},
    {'O', {0x0E, 0x11, 0x0E}},
    {'P', {0x1F, 0x05, 0x02}},
    {'Q', {0x0E, 0x19, 0x1E}},
    {'R', {0x1F, 0x05, 0x1A}},
    {'S', {0x12, 0x15, 0x09}},
    {'T', {0x01, 0x1F, 0x01}},
    {'U', {0x0F, 0x10, 0x0F}},
    {'V', {0x07, 0x18, 0x07}},
    {'W', {0x1F, 0x08, 0x1F}},
    {'X', {0x1B, 0x04, 0x1B}},
    {'Y', {0x03, 0x1C, 0x03}},
    {'Z', {0x19, 0x15, 0x13}},
};

static const uint8_t s_lcd_space[3] = { 0, 0, 0 };

static inline const uint8_t *lcd_glyph(char c)
{
    if (c >= 'a' && c <= 'z') {
        c = (char)(c - 'a' + 'A');
    }
    for (unsigned i = 0; i < sizeof(s_lcd_font) / sizeof(s_lcd_font[0]); i++) {
        if (s_lcd_font[i].ch == c) {
            return s_lcd_font[i].col;
        }
    }
    return s_lcd_space;
}

#endif /* LCD_FONT3X5_H */
